/dts-v1/;
/plugin/;

/ {
    compatible = "brcm,bcm2837";

    fragment@0 {
        target-path = "/soc/serial@7e201000/bluetooth";

        __overlay__ {
            max-speed = <460800>;
            /* Deliver call audio over the HCI UART to the Linux SCO socket. */
            brcm,bt-pcm-int-params = [01 02 00 01 01];
        };
    };
};
